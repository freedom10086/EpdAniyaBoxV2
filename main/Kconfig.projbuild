## main/Kconfig.projbuild
```kconfig
menu "My Project Config"

    menu "LCD Config"
        comment "config spi display stuff."
        choice SPI_DISPLAY_TYPE
        prompt "LCD Display Type:"
            default SPI_DISPLAY_SSD1680_1IN54
            help
                  Select the display driver type.
            config SPI_DISPLAY_SSD1680_1IN54
                bool "SPI_DISPLAY_SSD1680_1IN54"
            config SPI_DISPLAY_SSD1680_1IN54_V1
                bool "SPI_DISPLAY_SSD1680_1IN54_V1"
            config SPI_DISPLAY_ST7789
                bool "SPI_DISPLAY_ST7789"
        endchoice
    endmenu

    menu "BLE Device Config"
        comment "config ble device"

        config ENABLE_BLE_DEVICES
            bool "enable ble devices"
    endmenu

endmenu
```

## sdkconfig.defaults
```kconfig
CONFIG_BT_ENABLED=y
CONFIG_BT_NIMBLE_ENABLED=y
CONFIG_BT_NIMBLE_ATT_PREFERRED_MTU=517
```
